## main/Kconfig.projbuild
```kconfig
menu "TapTalk"

    config TAPTALK_ENABLE_HID
        bool "Enumerate as a USB HID keyboard"
        default y
        help
            Installs TinyUSB and types transcripts into the host.

            Turning this OFF is a bring-up aid: TinyUSB takes over the USB PHY
            from the USB-Serial-JTAG controller, so with it on you can no
            longer flash over USB while the app runs (hold BOOT, tap PWR), and
            the console moves to the composite CDC interface. With it off, the
            transcript is only logged.

    config TAPTALK_TRAILING_SPACE
        bool "Type a space after each transcript"
        default y
        help
            Lets you dictate several phrases in a row without them running
            together. Never types Enter: that would submit forms.

    config TAPTALK_KEY_INTERVAL_MS
        int "Milliseconds between keystrokes"
        default 6
        range 2 50
        help
            A USB boot keyboard is polled every few milliseconds. Sending
            faster than the host polls loses keys. Raise this if characters go
            missing on a particular machine.

    config TAPTALK_BEEP
        bool "Confirmation tones through the speaker"
        default y
        help
            The board has no haptic motor, so a short tone is the only way to
            confirm a press without looking at the screen.

            The press tone is played into the same room as the microphone that
            is about to start recording, so audio_capture.c discards the first
            BEEP_PRESS_MS of every clip. Turning this off also turns off that
            discard.

    config TAPTALK_HID_DELAY_MS
        int "Delay before installing TinyUSB (debug)"
        default 0
        range 0 60000
        help
            Installing TinyUSB moves the console from USB-Serial-JTAG to a CDC
            interface, and the USB-Serial-JTAG port disappears at that moment.
            Every log line before that is only visible on a port that then goes
            away -- which is why a boot-time hang looks like silence.

            Set this to e.g. 20000 to keep the boot console alive long enough to
            watch what happens. Leave it at 0 for real builds: it delays the
            keyboard becoming usable by exactly this much.

    config TAPTALK_WATCH_LVGL
        bool "Subscribe the LVGL task to the task watchdog (debug)"
        default n
        help
            Makes a wedged render task print its own backtrace every few
            seconds. Noisy on purpose; never enable in a real build.

endmenu
```

## sdkconfig.defaults
```kconfig
CONFIG_IDF_TARGET="esp32s3"

# 16 MB Winbond W25Q128 on the standard SPI bus.
CONFIG_ESPTOOLPY_FLASHSIZE_16MB=y
CONFIG_ESPTOOLPY_FLASHMODE_QIO=y
CONFIG_ESPTOOLPY_FLASHFREQ_80M=y

CONFIG_PARTITION_TABLE_CUSTOM=y
CONFIG_PARTITION_TABLE_CUSTOM_FILENAME="partitions.csv"

# The module is an ESP32-S3R8: 8 MB of in-package OCTAL PSRAM. Quad mode here
# would silently fail to detect it, and the 960 KB audio clip has nowhere else
# to live.
CONFIG_SPIRAM=y
CONFIG_SPIRAM_MODE_OCT=y
CONFIG_SPIRAM_SPEED_80M=y
CONFIG_SPIRAM_USE_MALLOC=y

# LVGL's draw buffer now lives in internal DMA memory (see app_main.c), which
# costs 29 KB of a scarce pool. Wi-Fi and lwIP buffers pay it back: PSRAM is no
# longer on the display's critical path, so there is nothing left for them to
# contend with there.
CONFIG_SPIRAM_TRY_ALLOCATE_WIFI_LWIP=y

# REQUIRED, not cosmetic. The BSP puts LVGL's draw buffer in PSRAM
# (buff_spiram = true) and the SH8601 driver DMAs straight out of it. The
# default is a 32-byte data cache line, and with Octal PSRAM the SPI master
# then rejects the buffer: every flush fails with
#   E lcd_panel.io.spi: panel_io_spi_tx_color(395): spi transmit (queue) color failed
# and the panel shows a torn, half-painted frame. All three of Waveshare's
# display examples set this; omitting it cost a bring-up cycle.
CONFIG_ESP32S3_DATA_CACHE_LINE_64B=y

CONFIG_ESP_DEFAULT_CPU_FREQ_MHZ_240=y
CONFIG_FREERTOS_HZ=1000

# Early boot logs on USB-Serial-JTAG; once hid_kbd_start() installs TinyUSB the
# PHY moves to the OTG controller and esp_tusb_init_console() redirects the log
# to the composite CDC interface. The device re-enumerates at that moment.
CONFIG_ESP_CONSOLE_USB_SERIAL_JTAG=y
CONFIG_ESP_MAIN_TASK_STACK_SIZE=6144

# TinyUSB: one CDC (console) + one HID (keyboard), on core 0 with the radio.
CONFIG_TINYUSB_CDC_ENABLED=y
CONFIG_TINYUSB_CDC_COUNT=1
CONFIG_TINYUSB_HID_COUNT=1
CONFIG_TINYUSB_TASK_AFFINITY_CPU0=y

# TLS to api.openai.com chains to GTS Root R4 (cross-signed by GlobalSign).
# The FULL bundle is used rather than the reduced filter because I could not
# confirm GTS Root R4 is in the reduced set, and a missing root is a runtime
# handshake failure with a misleading error.
CONFIG_MBEDTLS_CERTIFICATE_BUNDLE=y
CONFIG_MBEDTLS_CERTIFICATE_BUNDLE_DEFAULT_FULL=y
# The handshake buffers are large; freeing them between requests keeps the
# 960 KB clip and LVGL's framebuffers from fighting over heap.
CONFIG_MBEDTLS_DYNAMIC_BUFFER=y
CONFIG_MBEDTLS_DYNAMIC_FREE_PEER_CERT=y
CONFIG_MBEDTLS_DYNAMIC_FREE_CONFIG_DATA=y

# LVGL: 16-bit colour matches the SH8601's RGB565 pipeline.
CONFIG_LV_COLOR_DEPTH_16=y
CONFIG_LV_FONT_MONTSERRAT_28=y
CONFIG_LV_FONT_MONTSERRAT_36=y
CONFIG_LV_USE_QRCODE=y

# The BSP's bsp_display_start_with_config() ignores cfg->buffer_size and
# cfg->flags entirely -- it recomputes the buffer from Kconfig and hardcodes
# buff_dma=false. So these are the only knobs that do anything.
#
# The default of 100 rows is 368*100*2 = 147 KB. With buff_dma and buff_spiram
# both false, esp_lvgl_port allocates it with MALLOC_CAP_DEFAULT, and anything
# over SPIRAM_MALLOC_ALWAYSINTERNAL (16 KB by default) lands in PSRAM anyway.
# QSPI DMA out of PSRAM, with the 64-byte cache line octal PSRAM requires, is
# what painted the setup screen in white bands.
#
# 16 rows is 368*16*2 = 11,776 bytes, which is under ESP-IDF's DEFAULT
# SPIRAM_MALLOC_ALWAYSINTERNAL threshold of 16384. So the buffer lands in
# internal RAM -- DMA-capable and cache-coherent -- without touching the
# threshold at all.
#
# It previously used 32 rows (23,552 B) and RAISED the threshold to 32768 to
# force that allocation internal. That forced EVERY sub-32KB allocation
# internal too: Wi-Fi, lwIP, TinyUSB, httpd, and the SPI driver's DMA
# descriptors. Internal free fell from 73K to 63K with a largest block of 31K,
# and esp_lcd_panel_draw_bitmap() started failing -- at which point
# esp_lvgl_port never calls lv_display_flush_ready(), and the render task waits
# forever holding the LVGL lock. The screen freezes; every other task keeps
# running, so the log looks healthy.
#
# Never widen a global allocator policy to satisfy one allocation.
CONFIG_BSP_DISPLAY_LVGL_BUF_HEIGHT=16

# Four-stop background gradient. LVGL's default cap is 2, which bands visibly
# across 448 px on an AMOLED.
CONFIG_LV_GRADIENT_MAX_STOPS=4

# Compile DEBUG in; app_main raises our own tags to it. Without this the calls
# are stripped by the preprocessor and no runtime switch can bring them back.
CONFIG_LOG_MAXIMUM_LEVEL_DEBUG=y


# LVGL fails silently by default: LV_ASSERT_HANDLER is a bare `while(1);` and
# LV_USE_LOG is off, so an out-of-memory inside the renderer hangs the task
# without printing anything. It cost a day. Now it says "Out of memory" first.
CONFIG_LV_USE_LOG=y
CONFIG_LV_LOG_LEVEL_WARN=y
CONFIG_LV_LOG_PRINTF=y
```
